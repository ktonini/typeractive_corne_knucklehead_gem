## config/west.yml
```yaml
manifest:
  remotes:
    - name: zmkfirmware
      url-base: https://github.com/zmkfirmware
    - name: urob
      url-base: https://github.com/urob
    - name: m165437
      url-base: https://github.com/M165437
    - name: ktonini
      url-base: https://github.com/ktonini
  projects:
    - name: zmk
      remote: zmkfirmware
      revision: ac7f75b8591d39aaf3b66b9d26f26c9ed921a009
      import: app/west.yml
    - name: zmk-auto-layer
      remote: urob
      revision: main
    - name: zmk-tri-state
      remote: urob
      revision: main
    - name: nice-view-gem
      remote: ktonini
      revision: main
  self:
    path: config
```
